/* Written by Walter Lohmueller
*/
//////SENSOR LIBRARIES///////////
#include <SPI.h>

#include <Adafruit_LSM6DS33.h>

// For SPI mode, we need a CS pin
#define LSM_CS 10
// For software-SPI mode we need SCK/MOSI/MISO pins
#define LSM_SCK 13
#define LSM_MISO 12
#define LSM_MOSI 11
#include <math.h>
Adafruit_LSM6DS33 lsm6ds33;

////////STATE ESTIMATE VARIABLES/////////
#include <math.h>

//BARAOMETER//
float SD_pad_close = 0;
float alt_speed = 0;
float alt_past = 0;
float alt_present = 0;
float altitude_previous = 0;
float temperature, pressure, altitude;  // Create the temperature, pressure and altitude variables
float altitudeoffset = 0;               //set the offset variable to get altitude above ground level
float Altitude_true = 0;                //altitude above the ground
float altfilt = 0;                      // variable to filter altitude data
float apogee = -1;
float accel_altitude_new = 0;

//IMU//
float accely = 0;
float accelx = 0;
float accelz = 0;
float accelx_old = 0;

float accel_true = 0;

float gyroz = 0;
float gyrox = 0;
float gyroy = 0;

float gyrox_offset;
float gyroy_offset;
float gyroz_offset;

float gyrox_offset1;
float gyroy_offset1;
float gyroz_offset1;

float gyrox_offset2;
float gyroy_offset2;
float gyroz_offset2;

float anglex;
float angley;
float anglez;

float accel_pitch;
float accel_roll;

float anglex_old;
float angley_old;
float anglez_old;


float velocity_offset = 0;
float altitude_offset = 0;
float offset_counter = 1;
float velocity_new = 0;
float velocity_old = 0;
float velocity_change = 0;
float accel_altitude = 0;

float launch_count = 0;
/////TIMEKEEPER//////////
float millisoffset = 0;  // variable to offset millis
float Time;              // set up time at start of loop
float time_actual;       //set up the difference in time, also the actual time
float time_offset;       // set up the time offset
float time_old = 0;
float time_new = 0;
float Time_step = 0;
///////////////////GUIDENCE NAVIGATION CONTROL///////////////////////
#include <Servo.h>
Servo Servo1;  //declare two servos
Servo Servo2;
float stopping_distance = 0;
float speed_alt_const = 0.29;
float SD_close_counter = 1;
float parachute_deploy_counter = 0;
float deploy_error = 0;

Servo roll_servo;  //declare two servos
Servo pitch_servo;
Servo roll_servo1;
Servo pitch_servo1;

float Pitch_servo;
float Roll_servo;

float pitch_error;
float roll_error;

float pitch_target = 0;
float roll_target = 0;

float starting_pitch = 0;
float starting_roll = 0;

float MMOI = 0.00638;
float required_side_forcex = 0;
float required_side_forcey = 0;
float moment_arm = 0.28;
float thrust = 0;
float mass = 0.7;


//-----------------------------------------
//Quaternion Integration variables
//-----------------------------------------
float Quat[5] = {0.0, 1.0, 0.0, 0.0, 0.0};
float gyro_gain = 0.07;
float ddx;
float ddy;
float ddz;
unsigned long lastRotn = 0UL;
unsigned long rotnRate = 10000UL;//100 updates per second

//-----------------------------------------
//gyro & rotation variables
//-----------------------------------------
long dx = 0L;
long dy = 0L;
long dz = 0L;
int pitchX;
int yawY;
long rollZ = 0;
const float degRad = 57.29577951308; //degrees per radian
const float mlnth = 0.000001;
int offVert = 0;


//////////SOFTWARE IN THE LOOP/////////////////
//0,0,0,0,0,0,0,0,0,0,0,0,0,0,0,0,0,0,0,0,0,0,0,0,0,
//float SITL_accelx[] = {0.2,0.2,0.2,0.2,0.2,0.2,0.2,0.2,0.2,0.2,0.2,0.2,0.2,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32.86,-9.44};
//float SITL_accelx[] = {0,0,0,0,0,0,0,0,0,0,0,0,0,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-11.67,-10.83};

//float SITL_accelx[] = {0,0,0,0,0,0,0,0,0,0,0,0,0,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 -10.155603332106978 , -10.179989394656797};
//float SITL_accelx[] = {0,0,0,0,0,0,0,0,0,0,0,0,0,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-23.13,-21};
//2,2,2,2,2,2,2,2,2,2,2,2,2,2,2,2,2,2,2,2,2
//float SITL_accelx[] = {0,0,0,0,0,0,0,0,0,0,0,0,0,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 -10.105240708432953 , -10.129710399392165};


int i = 1;
int a = -1;
int f = 0;

/////////DATALOGGING///////////////////
#include <SD.h>
File dataFile;  //set data fi\le for micro sd card
float chipSelect = 4;
//////////////////STATE MACHINE/////////////////////////
float recalibratecounter = 0;  // a counter that is used to tell when to recalibrate the sensors
float systemstate = -1;        // a system state variable to switch from pad idle to launch
int errorboi = 0;              //set this variable high if errors are detected


/////////////////////FUNCTION PROTOTYPES////////////////////////////////////
float DATALOG();
float alt_update();
float SITLread_IMU();
float SITLread_baro();
float error_check_read_IMU();  //both read IMU and error checking features in one function. logic is inside the function
float read_IMU();
float read_baro();
float find_recalibrate();
float Estimate_state();
float error_check();
float recalibrate_sensor();
float pad_print();  // data to print on the pad
float get_offsets();
float advance_state();
//float LQR_control();
float caculate_angles();
float parachute_deploy();
float chute_deploy();
int speedAtan2();


void setup() {
  Serial.begin(115200);  // start serial monitor
  ////////////////////START SENSORS//////////////////////////////////
  pinMode(3, OUTPUT);

  SD.begin(chipSelect);  // start the SD card
Wire.setClock(400000);

  if (!lsm6ds33.begin_I2C()) {
    // if (!lsm6ds33.begin_SPI(LSM_CS)) {
    // if (!lsm6ds33.begin_SPI(LSM_CS, LSM_SCK, LSM_MISO, LSM_MOSI)) {
    Serial.println("Failed to find LSM6DS33 chip");
  }

  lsm6ds33.configInt1(false, false, true);  // accelerometer DRDY on INT1
  lsm6ds33.configInt2(false, true, false);  // gyro DRDY o

 // recalibrate_sensor();


  ///////////LED TEST///////////////////
/*
  pinMode(8, OUTPUT);
  digitalWrite(8, HIGH);
  delay(500);
  digitalWrite(8, LOW);
  delay(500);
  digitalWrite(8, HIGH);
  delay(500);
  digitalWrite(8, LOW);
*/
  /////////DRAG BRAKES//////////////////

  pitch_servo.attach(7);
  roll_servo.attach(5);  // Attaches the servo on pin 6 to the
  pitch_servo.write(90);
 roll_servo.write(80);
  delay(500);

  Serial.println(" Sensor startup complete, starting main loop ");
  dataFile.println(" Sensor startup complete, starting main loop ");
}

void loop() {

  ///////////////////////////STATE MACHINE////////////////////////////////////


  if (systemstate == -1) {
    Serial.print(" systemstate: Pad Idle ");
    dataFile.print(" systemstate: Pad Idle ");
    error_check_read_IMU();
  //  SITLread_IMU();
   // find_recalibrate ();
   // recalibrate_sensor();
   // read_baro();
   get_offsets();
    DATALOG();
    Estimate_state();
  }

  if (systemstate == 0) {
    Serial.print(" systemstate: Powered Flight ");
   dataFile.print(" systemstate: Powered Flight ");
  // find_recalibrate();
   // recalibrate_sensor();
    Estimate_state();
  //  alt_update();
    read_baro();
  //  SITLread_IMU();
   error_check_read_IMU();
    DATALOG();
    //LQR_control();
  
    caculate_angles();
  }

  if (systemstate == 1) {
    Serial.print(" systemstate: Burnout ");
    dataFile.print(" systemstate: Burnout ");
    Estimate_state();
    parachute_deploy();
    read_baro();
    DATALOG();
   // apogee_action();
   error_check_read_IMU();
  // SITLread_IMU();
  }




  ///////////////////////STATE ADVANCE/EXIT CONDITIONS/////////////////////////////////


  //apogee is called 7 seconds after liftoff
  /*
  if (time_actual > 30 && systemstate < 1) {
    systemstate = systemstate + 1;
  }
  */

//delay(39);
  // check the accelerometer to see if we have launched
  if (Time/1000 > 25 && systemstate < 0) {
    advance_state();
  }
  
  /////////////////////IF STATEMENTS//////////////////////////////////////////


  //Print out what data values are
  if(Time/1000 < 0.3) {
   pad_print();    
  }


 if (systemstate < 0) {
    //delay(100);
    time_offset = millis();
  }

  if (errorboi > 0) {
   // Servo1.write(95);
   // Servo2.write(90);
    digitalWrite(8, HIGH);
  } else {
   // Servo1.write(5);
   // Servo2.write(180);
    digitalWrite(8, LOW);
  }

  //////////////////////////TIME KEEPER//////////////////////////////////////////
  time_old = Time;
  Time = millis();
  time_new = Time;
  time_actual = Time / 1000 - time_offset / 1000;
  Time_step = time_old - time_new;
}




float advance_state() {
  systemstate = systemstate + 1;
}


float apogee_action() {
  //Serial.print(" apogee ");
  //dataFile.print(" apogee ");
  apogee = 1;
}


/* okay so this is really fucking stupid. whenver read_IMU is called outside the error check function
the readings will be erratic. As a result I will have to figure out how to split the error check functions into two 
parts that I can call seperatly
*/
float error_check_read_IMU() {
  if(systemstate  > -2) {
 read_IMU();
  }
/*
    if(systemstate > -1 && Time/1000 < 100) {
    errorboi = 1;
    Serial.print("premature launch");
    dataFile.print("premature launch");

  }
  */
  if(Time/1000 < 100) {
  //Serial.print( " error checking ");
  if (accelx < -3 && Time / 1000 < 40) {
    Serial.print(" rocket is not vertical ");
    dataFile.print(" rocket is not vertical ");

    errorboi = 1;
  }
  /*
 if (!SD.begin(4) && systemstate == -1) {
      errorboi = 1;
    dataFile.print(" SD card not avaliable! ");
    Serial.print(" SD card not avaliable! ");
   }
   */

  if (accelx == 0 && systemstate == -1 && Time/1000 < 100) {
    errorboi = 1;
    dataFile.print(" accelerometer not connected ");
    Serial.print(" accelerometer not connected ");

  }
  
  }

}




